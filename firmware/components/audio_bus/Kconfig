## firmware/components/audio_bus/Kconfig
```kconfig
menu "Shared audio bus"
    config AUDIO_BUS_SAMPLE_RATE
        int "Microphone and speaker sample rate (Hz)"
        range 8000 48000
        default 16000
        help
            Shared I2S frame rate. The default preserves the existing microphone
            configuration; hardware compatibility still needs verification.
endmenu
```

## firmware/components/display/Kconfig
```kconfig
menu "ST7789 240x240 display"
config DISPLAY_X_OFFSET
    int "Panel X RAM offset"
    range 0 80
    default 0
config DISPLAY_Y_OFFSET
    int "Panel Y RAM offset"
    range 0 80
    default 0
config DISPLAY_INVERT_COLORS
    bool "Invert panel colors"
    default y
endmenu
```

## firmware/components/voice_stream/Kconfig
```kconfig
menu "Microphone realtime prototype"
config VOICE_STREAM_PORT
    int "PC UDP bridge port"
    range 1024 65535
    default 5005
config VOICE_SPEAKER_PORT
    int "PC HTTP speaker mailbox port"
    range 1024 65535
    default 5006
endmenu
```
